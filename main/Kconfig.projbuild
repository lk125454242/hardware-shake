## main/Kconfig.projbuild
```kconfig
# put here your custom config value
# 注意：各 GPIO 不可重复。当前默认：OLED 8,9 | 加减速 5,6 | 启停 7,10 | 蜂鸣器 20。转速 1~100 由从机换算 RPM。
menu "Example Configuration"
config OLED_I2C_SDA_GPIO
    int "OLED I2C SDA GPIO"
    default 8
    help
        GPIO for I2C SDA (SSD1306). 勿与其它引脚重复。

config OLED_I2C_SCL_GPIO
    int "OLED I2C SCL GPIO"
    default 9
    help
        GPIO for I2C SCL (SSD1306). 勿与其它引脚重复。

config OLED_I2C_ADDR
    hex "OLED I2C 地址"
    default 0x3C
    help
        SSD1306 I2C 从机地址，常见 0x3C 或 0x3D。

config MOTOR_SLAVE_I2C_ADDR
    hex "电机从机 I2C 地址"
    default 0x20
    help
        步进电机驱动从机地址。主设备发：停止 0x00；启动 0x01；设转速 0x02,speed（speed 1~100，具体 RPM 由从机换算）。

config BTN_SPEED_UP_GPIO
    int "按钮 增加转速 GPIO"
    default 5
    help
        轻触开关，转速+1（1~100）。勿与其它引脚重复。

config BTN_SPEED_DOWN_GPIO
    int "按钮 减少转速 GPIO"
    default 6
    help
        轻触开关，转速-1（1~100）。勿与其它引脚重复。

config BTN_MOTOR_START_GPIO
    int "按钮3 电机启动 GPIO"
    default 7
    help
        轻触开关，电机启动。勿与其它引脚重复。

config BTN_MOTOR_STOP_GPIO
    int "按钮 电机停止 GPIO"
    default 10
    help
        轻触开关，电机停止。勿与其它引脚重复。

config BUZZER_GPIO
    int "有源蜂鸣器 GPIO"
    default 20
    help
        有源蜂鸣器，高电平响。仅倒计时结束自动停转时响，手动启停不响。勿与其它引脚重复。
endmenu
```
